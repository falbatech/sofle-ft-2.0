/ {
    encoders {
        compatible = "zmk,encoders";

        right_encoder: encoder_right {
            a-gpios = <&gpio0 21 (GPIO_PULL_UP | GPIO_ACTIVE_LOW)>;
            b-gpios = <&gpio0 22 (GPIO_PULL_UP | GPIO_ACTIVE_LOW)>;
            steps = <4>;
        };
    };
};

&led_strip {
    status = "okay";
    chain-length = <36>;
    color-mapping = <LED_COLOR_ID_GRB>;
    pin = <6>;
};
